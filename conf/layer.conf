## conf/layer.conf
```bitbake
# We have a conf and classes directory, add to BBPATH
BBPATH .= ":${LAYERDIR}"

# We have recipes-* directories, add to BBFILES
BBFILES += "${LAYERDIR}/recipes-*/*/*.bb \
            ${LAYERDIR}/recipes-*/*/*.bbappend"

BBFILE_COLLECTIONS += "meta-sv"
BBFILE_PATTERN_meta-sv = "^${LAYERDIR}/"
BBFILE_PRIORITY_meta-sv = "10"

LAYERDEPENDS_meta-sv = "core"
LAYERSERIES_COMPAT_meta-sv = "kirkstone"
```
